#include <ble_types.h>
#include <esp_log.h>
#include <ble_consts.h>
#include <string.h>
#include <ble_fifo.h>

typedef enum {
    RX_WAIT_MAGIC,
    RX_READ_HEADER,
    RX_READ_PAYLOAD
} rx_state_t;

typedef struct {
    rx_state_t state;
    ble_msg_t cur_msg;
    uint16_t offset;
    bool msg_active;
} rx_ctx_t;

typedef struct
{
    ble_msg_t cur_msg;
    uint16_t offset;
    bool msg_active;
} tx_ctx_t;

static rx_ctx_t rx_ctx;
static tx_ctx_t tx_ctx;
static const char* TAG = "Packet Handler";

void rx_reset_context(void)
{
    rx_ctx.state = RX_WAIT_MAGIC;
    rx_ctx.offset = 0;
    rx_ctx.msg_active = false;
}

void tx_reset_context(void) {
    tx_ctx.msg_active = false;
    tx_ctx.offset = 0;
}

/**
 * @brief Builds the next BLE TX packet from the internal message FIFO.
 *
 * This function encodes one MTU-sized BLE packet into the global TX buffer
 * (`tx_buffer`) by consuming messages from the internal FIFO.
 *
 * @verbatim
 * It performs message fragmentation across packets while preserving message
 * boundaries using a per-message header and a continuation flag at packet level.
 *
 * ---
 *
 * ## Wire Format
 *
 * Each BLE packet generated by this function has the following format:
 *
 * ```
 * [ MSG_CONT ][ MESSAGE STREAM ... ]
 * ```
 *
 * Where:
 *
 * - MSG_CONT (1 byte)
 *      - 1 = continuation of previous message stream
 *      - 0 = new stream start
 *
 * Each message inside the stream has the format:
 *
 * ```
 * [ MAGIC ][ OPCODE ][ REQ_APP ][ LEN ][ PAYLOAD... ]
 * ```
 *
 * Where:
 *
 * - MAGIC   : 1 byte message boundary identifier
 * - OPCODE  : application-defined command opcode
 * - REQ_APP : requesting application ID
 * - LEN     : payload length in bytes
 * - PAYLOAD : variable length data (may be fragmented across packets)
 *
 * ---
 *
 * ## Fragmentation Rules
 *
 * - Only the PAYLOAD field may be fragmented across multiple BLE packets.
 * - Message headers are always sent atomically (never split).
 * - Messages are read sequentially from the FIFO.
 * - If a message does not fully fit in the current MTU, it is continued in
 *   the next packet without repeating the header.
 *
 * ---
 * @endverbatim
 *
 * @param out_len
 *
 * @return Returns true if packet contains data, false if FIFO empty
 */
bool ble_build_next_packet(uint8_t* tx_buffer, uint16_t effective_mtu, uint16_t *out_len)
{
    if ((out_len==NULL) || (tx_buffer==NULL)) return false;

    uint16_t i = 0;
    ESP_LOGD(TAG, "Build packet for MTU : %02u", effective_mtu);
    // packet-level continuation flag
    tx_buffer[i++] = tx_ctx.msg_active ? 1 : 0;

    while (i < effective_mtu) {

        /* Load next message if needed */
        if (!tx_ctx.msg_active) {
            if (!get_next_ble_msg(&tx_ctx.cur_msg, BLE_TX)) {
                break; // FIFO empty
            }

            tx_ctx.offset = 0;
            tx_ctx.msg_active = true;
        }

        uint16_t remaining_msg = tx_ctx.cur_msg.hdr.len - tx_ctx.offset;
        uint16_t remaining_pkt = effective_mtu - i;

        /* Ensure header fits when starting a new message */
        if (tx_ctx.offset == 0 && remaining_pkt < (1 + BLE_HDR_SIZE)) {
            break;
        }

        /* Write message header once per message */
        if (tx_ctx.offset == 0) {

            tx_buffer[i++] = BLE_MAGIC;

            tx_buffer[i++] = tx_ctx.cur_msg.hdr.opcode;
            tx_buffer[i++] = tx_ctx.cur_msg.hdr.req_app;
            tx_buffer[i++] = tx_ctx.cur_msg.hdr.len;
        }

        remaining_pkt = effective_mtu - i;
        uint16_t chunk = (remaining_msg < remaining_pkt)
                            ? remaining_msg
                            : remaining_pkt;

        memcpy(&tx_buffer[i], &tx_ctx.cur_msg.payload[tx_ctx.offset], chunk);
        i += chunk;
        tx_ctx.offset += chunk;

        /* message complete */
        if (tx_ctx.offset >= tx_ctx.cur_msg.hdr.len) {
            tx_ctx.msg_active = false;
        }

        /* packet full */
        if (i >= effective_mtu) break;
    }

    *out_len = i;
    return (i > 1);
}

void dump_ble_packet(const uint8_t *pkt, uint16_t len)
{
    if (!pkt || len == 0) {
        ESP_LOGI(TAG, "EMPTY PACKET");
        return;
    }

    uint16_t i = 0;
    uint8_t msg_cont = pkt[i++];

    ESP_LOGI(TAG, "BLE PACKET DUMP");
    ESP_LOGI(TAG, "MSG_CONT: %u", msg_cont);

    /* =========================================================
     * STREAM MODE (BOTH CONTINUATION AND START BEHAVES SAME)
     * ========================================================= */
    while (i < len) {

        /* Wait for message boundary */
        if (pkt[i] != BLE_MAGIC) {

            ESP_LOGI(TAG, "RAW [%u]: 0x%02X", i, pkt[i]);
            i++;
            continue;
        }

        /* ---- MESSAGE START ---- */
        i++; // skip MAGIC

        if (i + 3 > len) {
            ESP_LOGI(TAG, "TRUNCATED HEADER");
            return;
        }

        uint8_t opcode  = pkt[i++];
        uint8_t req_app = pkt[i++];
        uint8_t msg_len = pkt[i++];

        ESP_LOGI(TAG, "---- MESSAGE ----");
        ESP_LOGI(TAG, "OPCODE  : 0x%02X", opcode);
        ESP_LOGI(TAG, "REQ_APP : %u", req_app);
        ESP_LOGI(TAG, "LEN     : %u", msg_len);

        uint16_t remaining = len - i;
        uint16_t available = (msg_len < remaining) ? msg_len : remaining;

        ESP_LOGI(TAG, "PAYLOAD:");

        for (uint16_t k = 0; k < available; k++) {
            ESP_LOGI(TAG, "  [%u] 0x%02X", k, pkt[i + k]);
        }

        if (available < msg_len) {
            ESP_LOGI(TAG, "  ... TRUNCATED (%u/%u)", available, msg_len);
        }

        i += available;
    }

    ESP_LOGI(TAG, "END PACKET");
}


void ble_retrieve_packet(const uint8_t *pkt, uint16_t len)
{
    if (!pkt || len == 0) return;

    uint16_t i = 0;

    uint8_t msg_cont = pkt[i++];

    /* =========================================================
     * CONTINUATION HANDLING
     * ========================================================= */
    if (msg_cont == 0) {
        /* New stream → reset parser */
        rx_ctx.state = RX_WAIT_MAGIC;
        rx_ctx.offset = 0;
        rx_ctx.msg_active = false;
    }
    else {
        /* Continuation expected but no active message → resync */
        if (!rx_ctx.msg_active) {
            ESP_LOGE(TAG, "Unexpected continuation packet → resync");
            rx_ctx.state = RX_WAIT_MAGIC;
            rx_ctx.offset = 0;
        }
    }

    /* =========================================================
     * STREAM PARSER
     * ========================================================= */
    while (i < len) {

        switch (rx_ctx.state) {

        /* ---------------- WAIT FOR MAGIC ---------------- */
        case RX_WAIT_MAGIC:

            if (pkt[i] != BLE_MAGIC) {
                i++; /* Skip garbage */
                break;
            }

            // Handling edge case where we are already in desync and trying to
            // find next magic, say we get magic in last byte of packet now we
            // shouldnt consume the magic and set state to header as header
            // will start from next packet first byte (MSG_CONT flag byte) and
            // fail copying garbage in payload (as len is incorrect)
            if (i + 4 > len) {
               /* Not enough bytes for full header → wait next packet */
                ESP_LOGE(TAG, "Protocol violation: partial header detected at packet boundary");
                return;
            }

            /* Found potential message start */
            rx_ctx.state = RX_READ_HEADER;
            i++;
            break;

        /* ---------------- READ HEADER ---------------- */
        case RX_READ_HEADER:

            if (i + 3 > len) {
                /* Incomplete header → wait next packet */
                return;
            }

            rx_ctx.cur_msg.hdr.opcode  = pkt[i++];
            rx_ctx.cur_msg.hdr.req_app = pkt[i++];
            rx_ctx.cur_msg.hdr.len     = pkt[i++];

            /* Length validation */
            if (rx_ctx.cur_msg.hdr.len > BLE_MAX_PAYLOAD_SIZE) {
                ESP_LOGE(TAG, "Invalid length: %u", rx_ctx.cur_msg.hdr.len);

                /* Resync instead of drop-all */
                rx_ctx.state = RX_WAIT_MAGIC;
                rx_ctx.msg_active = false;
                // Unconsume the 3 bytes of header
                i = i-3;
                break;
            }

            rx_ctx.offset = 0;
            rx_ctx.msg_active = true;

            /* ----------- HANDLE EMPTY PAYLOAD ----------*/
            if (rx_ctx.cur_msg.hdr.len == 0) {

                add_ble_msg_to_queue(&rx_ctx.cur_msg, BLE_RX);

                rx_ctx.msg_active = false;
                rx_ctx.state = RX_WAIT_MAGIC;
                break;
            }

            rx_ctx.state = RX_READ_PAYLOAD;
            break;

        /* ---------------- READ PAYLOAD ---------------- */
        case RX_READ_PAYLOAD: {
            /* Prevent overflow in case of corruption */
            if (rx_ctx.offset > rx_ctx.cur_msg.hdr.len) {
                ESP_LOGE(TAG, "RX offset overflow → resync");
                rx_ctx.state = RX_WAIT_MAGIC;
                rx_ctx.msg_active = false;
                break;
            }
            uint16_t remaining_msg = rx_ctx.cur_msg.hdr.len - rx_ctx.offset;
            uint16_t remaining_pkt = len - i;

            uint16_t chunk = (remaining_msg < remaining_pkt)
                                ? remaining_msg
                                : remaining_pkt;

            memcpy(&rx_ctx.cur_msg.payload[rx_ctx.offset], &pkt[i], chunk);

            rx_ctx.offset += chunk;
            i += chunk;

            /* Message complete */
            if (rx_ctx.offset >= rx_ctx.cur_msg.hdr.len) {

                add_ble_msg_to_queue(&rx_ctx.cur_msg, BLE_RX);

                rx_ctx.msg_active = false;
                rx_ctx.state = RX_WAIT_MAGIC;
            }

            break;
        }

        default:
            rx_ctx.state = RX_WAIT_MAGIC;
            break;
        }
    }
}

